#include <Arduino.h>
#include <Wire.h>
#include <U8g2lib.h>
#include "config.h"

// 创建SH1106 OLED显示对象 - 使用I2C接口
// 第一个参数U8G2_R0代表不旋转显示
// 使用config.h中定义的I2C地址和引脚
U8G2_SH1106_128X64_NONAME_F_HW_I2C u8g2(U8G2_R0, /* reset=*/ U8X8_PIN_NONE);

void setup() {
  Serial.begin(115200);
  
  // 等待串口连接
  while (!Serial) delay(10);
  
  Serial.println("\nSH1106 OLED Display Test with U8g2");
  
  // 初始化I2C，使用config.h中定义的引脚
  Wire.begin(I2C_SDA, I2C_SCL);
  
  // 初始化U8g2
  u8g2.begin();
  u8g2.clearBuffer();                   // 清除内部缓冲区
  u8g2.setFont(u8g2_font_ncenB08_tr);   // 设置字体
  
  // 显示基本文本
  u8g2.drawStr(0, 10, "SH1106 OLED Test");
  u8g2.drawStr(0, 25, "Balance Bot Project");
  
  char addressStr[20];
  sprintf(addressStr, "I2C Address: 0x%02X", I2C_OLED_ADDR);
  u8g2.drawStr(0, 40, addressStr);
  
  u8g2.sendBuffer();                    // 将内容传输到显示器
  delay(2000);
}

void drawLogo() {
  // 简单的自定义图标
  static const uint8_t logo[] = {
    0x00, 0x00, 0x00, 0x00, 0x00, 0x00, 0x00, 0x00,
    0x00, 0x00, 0x3E, 0x00, 0x00, 0x00, 0x00, 0x00,
    0x00, 0x00, 0x7F, 0x00, 0x00, 0x00, 0x00, 0x00,
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    0x00, 0x00, 0x00, 0x7F, 0xFF, 0xFF, 0xF8, 0x00
  };
  
  u8g2.drawXBM(32, 0, 64, 32, logo);
}

void loop() {
  // 循环展示不同的测试效果
  
  // 1. 显示文本
  u8g2.clearBuffer();
  u8g2.setFont(u8g2_font_ncenB08_tr);
  u8g2.drawStr(0, 10, "SH1106 Test");
  u8g2.sendBuffer();
  delay(1000);
  
  // 2. 显示方框
  u8g2.clearBuffer();
  u8g2.drawFrame(5, 5, 118, 54);
  u8g2.sendBuffer();
  delay(1000);
  
  // 3. 显示填充方框
  u8g2.clearBuffer();
  u8g2.drawBox(20, 20, 80, 30);
  u8g2.sendBuffer();
  delay(1000);
  
  // 4. 显示圆
  u8g2.clearBuffer();
  u8g2.drawCircle(64, 32, 20, U8G2_DRAW_ALL);
  u8g2.sendBuffer();
  delay(1000);
  
  // 5. 显示自定义图标
  u8g2.clearBuffer();
  drawLogo();
  u8g2.sendBuffer();
  delay(1000);
  
  // 6. 显示不同字体大小的文本
  u8g2.clearBuffer();
  u8g2.setFont(u8g2_font_ncenB10_tr);
  u8g2.drawStr(0, 15, "Balance");
  u8g2.setFont(u8g2_font_ncenB14_tr);
  u8g2.drawStr(20, 45, "Bot");
  u8g2.sendBuffer();
  delay(2000);
  
  // 7. 显示水平线和垂直线
  u8g2.clearBuffer();
  for(int i = 0; i < 64; i += 4) {
    u8g2.drawHLine(0, i, i*2);
  }
  for(int i = 0; i < 128; i += 8) {
    u8g2.drawVLine(i, 0, 64-(i/2));
  }
  u8g2.sendBuffer();
  delay(2000);
  
  // 8. 显示像素点
  u8g2.clearBuffer();
  for(int y = 0; y < 64; y += 4) {
    for(int x = 0; x < 128; x += 4) {
      if((x + y) % 8 == 0) {
        u8g2.drawPixel(x, y);
      }
    }
  }
  u8g2.sendBuffer();
  delay(2000);
  
  Serial.println("重新开始 OLED 测试循环...");
}